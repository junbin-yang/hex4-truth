## esp32s3_hex4_ulp/project/sdkconfig.defaults
```kconfig
# HEX4-Lift ESP32-S3 ULP 工程默认配置
CONFIG_IDF_TARGET="esp32s3"

# 使能 ULP-RISC-V 协处理器
CONFIG_ULP_COPROC_ENABLED=y
CONFIG_ULP_COPROC_TYPE_RISCV=y
# RTC SLOW 8KB 预留上限 (8176B), 供 ULP 固件 + mailbox
CONFIG_ULP_COPROC_RESERVE_MEM=8176

# 日志等级调低, 输出干净
CONFIG_BOOTLOADER_LOG_LEVEL_WARN=y
CONFIG_BOOTLOADER_LOG_LEVEL=2
CONFIG_LOG_DEFAULT_LEVEL_WARN=y
CONFIG_LOG_DEFAULT_LEVEL=2

# 轻睡眠模式下降低空闲唤醒频率 (tickless idle)
CONFIG_FREERTOS_USE_TICKLESS_IDLE=y
```
